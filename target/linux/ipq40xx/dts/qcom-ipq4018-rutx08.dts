// SPDX-License-Identifier: GPL-2.0-or-later OR MIT

#include "qcom-ipq4018-rutx-shiftreg.dtsi"

/ {
	model = "Teltonika RUTX08";
	compatible = "teltonika,rutx08";

	soc {
		gpio-export {
			gpio_out {
				gpio-export,name = "gpio_out";
				gpio-export,output = <0>;
				gpios = <&shift_io 0 GPIO_ACTIVE_HIGH>;
			};
		};
	};
};
