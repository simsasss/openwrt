// SPDX-License-Identifier: GPL-2.0-or-later

#include "rtl838x.dtsi"

#include <dt-bindings/input/input.h>
#include <dt-bindings/gpio/gpio.h>
#include <dt-bindings/leds/common.h>

/ {
	memory@0 {
		device_type = "memory";
		reg = <0x0 0x8000000>;
	};
};

&spi0 {
	status = "okay";

	flash@0 {
		compatible = "jedec,spi-nor";
		reg = <0>;
		spi-max-frequency = <10000000>;

		partitions {
			compatible = "fixed-partitions";
			#address-cells = <1>;
			#size-cells = <1>;

			boot: partition@0 {
				label = "u-boot";
				reg = <0x0 0x80000>;
				read-only;
			};

			partition@80000 {
				label = "u-boot-env";
				reg = <0x80000 0x10000>;
				read-only;
			};

			config: partition@90000 {
				compatible = "nvmem-cells";
				label = "config";
				reg = <0x90000 0x10000>;
				#address-cells = <1>;
				#size-cells = <1>;
				read-only;

				macaddr_config_0: macaddr@0 {
					reg = <0x0 0x6>;
				};
			};

			partition@a00000 {
				label = "firmware";
				reg = <0xa0000 0xed0000>;
				compatible = "denx,uimage";
			};

			partition@f70000 {
				label = "event-log";
				reg = <0xf70000 0x90000>;
			};
		};
	};
};

&uart1 {
	status = "okay";
};

&mdio_bus0 {
		compatible = "realtek,rtl838x-mdio";
		regmap = <&ethernet0>;
		#address-cells = <1>;
		#size-cells = <0>;

		INTERNAL_PHY(8)
		INTERNAL_PHY(9)
		INTERNAL_PHY(10)
		INTERNAL_PHY(11)
		INTERNAL_PHY(12)
		INTERNAL_PHY(13)
		INTERNAL_PHY(14)
		INTERNAL_PHY(15)

		INTERNAL_PHY(24)
		INTERNAL_PHY(26)
};

&switch0 {
	ports {
		#address-cells = <1>;
		#size-cells = <0>;

		SWITCH_PORT(8, 1, internal)
		SWITCH_PORT(9, 2, internal)
		SWITCH_PORT(10, 3, internal)
		SWITCH_PORT(11, 4, internal)
		SWITCH_PORT(12, 5, internal)
		SWITCH_PORT(13, 6, internal)
		SWITCH_PORT(14, 7, internal)
		SWITCH_PORT(15, 8, internal)

		port@24 {
			reg = <24>;
			label = "sfp1";
			phy-mode = "1000base-x";
			phy-handle = <&phy24>;
			managed = "in-band-status";
			sfp = <&sfp0>;
			nvmem-cells = <&macaddr_config_0>;
			nvmem-cell-names = "mac-address";
			mac-address-increment = <9>;
		};

		port@26 {
			reg = <26>;
			label = "sfp2";
			phy-mode = "1000base-x";
			phy-handle = <&phy26>;
			managed = "in-band-status";
			sfp = <&sfp1>;
			nvmem-cells = <&macaddr_config_0>;
			nvmem-cell-names = "mac-address";
			mac-address-increment = <10>;
		};

		port@28 {
			ethernet = <&ethernet0>;
			reg = <28>;
			phy-mode = "internal";
			is-cpu= <1>;

			fixed-link {
				speed = <1000>;
				full-duplex;
			};
		};
	};
};
