// SPDX-License-Identifier: GPL-2.0-or-later OR MIT
/dts-v1/;

#include "mt7628an_teltonika_rut2xx.dtsi"

/ {
	compatible = "teltonika,rut241", "mediatek,mt7628an-soc";
	model = "Teltonika RUT241";
};
