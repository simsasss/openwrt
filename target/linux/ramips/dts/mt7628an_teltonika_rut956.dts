// SPDX-License-Identifier: GPL-2.0-or-later OR MIT
/dts-v1/;

#include "mt7628an_teltonika_rut9xx.dtsi"

/ {
	compatible = "teltonika,rut956", "mediatek,mt7628an-soc";
	model = "Teltonika RUT956";
};